## main/Kconfig.projbuild
```kconfig
menu "TRHC Firmware configuration"
menu "I2C Slaves"
config I2C_MASTER_SCL
    int "I2C Master SCL GPIO number"
	range 0 34
	default 19
	help
		GPIO number (IOxx) for I2C SCL.

		Some GPIOs are used for other purposes (flash connections, etc.) and cannot be used.

		GPIOs 35-39 are input-only so cannot be used to drive the One Wire Bus.

config I2C_MASTER_SDA
    int "I2C Master SDA GPIO number"
    range 0 34
    default 18
    help
        GPIO number (IOxx) for I2C SDA.

        Some GPIOs are used for other purposes (flash connections, etc.) and cannot be used.

        GPIOs 35-39 are input-only so cannot be used to drive the One Wire Bus.

config CCS811_I2C_ADDRESS
    hex "I2C Address for CCS811"
    default 0x5B
    help
        I2C address for CCS811 Gas quality sensor/
config LCD_I2C_ADDRESS
    hex "I2C Address for LCD screen"
    default 0x27
    help
        I2C address for HD44780-compatible LCD1602 device.
endmenu
menu "Slave configuration"
config CCS811_READY_MIN
   int "Wait n minutes before sending data from CCS811"
   default 20
config CCS811_BASE_SAVE_PERIOD
   int "Save CCS811 Baseline to NVS every n minutes"
   default 60
config LCD_COLUMNS
    int "LCD Display number of columns"
    range 1 20
    default 20

config LCD_ROWS
    int "LCD Display number of rows"
    range 1 20
    default 4
endmenu
menu "Touchpad config"
config TOUCH_INFO_NUMBER
    int "Touchpad pin number"
	range 0 10
	default 0
config TOUCH_FILTER_PERIOD
    int "(ms) Touchpad filter period"
	range 0 1000
	default 10
config TOUCH_THRESH_PERCENT
    int "(%) Touchpad threshold percentage"
	range 0 100
	default 80
endmenu
menu "WiFi Config"
config WIFI_SSID
    string "WiFi SSID"
    default "myssid"
    help
        SSID (network name) for the example to connect to.

config WIFI_PASS
    string "WiFi Password"
    default "mypassword"
    help
        WiFi password (WPA or WPA2) for the example to use.

config AP_WIFI_SSID
    string "AP WiFi SSID"
    default "ESP 0x01"
    help
        SSID (network name) for the example to connect to.

config AP_WIFI_PASS
    string "AP WiFi Pass"
    default "mypassword"
    help
        WiFi password (WPA or WPA2) for the example to use.

config WIFI_MAXIMUM_RETRY
    int "Maximum retry"
    default 5
    help
        Set the Maximum retry to avoid station reconnecting to the AP unlimited when the AP is really inexistent.
endmenu

menu "MQTT Config"
config MQTT_USERNAME
    string "MQTT Username"
    default "username"

config MQTT_PASSWORD
    string "MQTT Password"
    default "password"

config MQTT_CLIENT_ID
    string "MQTT Client ID"
    default "client_id"
endmenu
endmenu
```
